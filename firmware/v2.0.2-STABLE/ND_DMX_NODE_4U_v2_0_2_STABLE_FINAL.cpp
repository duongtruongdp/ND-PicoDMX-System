/*
  ND DMX NODE 4U v2.0.2 STABLE FINAL
  RP2040 + W5500 + four RS485 transmitters

  Recommended Arduino-Pico settings for a standard Raspberry Pi Pico:
    Board:       Raspberry Pi Pico
    CPU Speed:   133 MHz
    Flash Size:  2MB (no filesystem required)
    USB Stack:   Pico SDK
    Optimize:    Small (-Os)

  Architecture:
    Core 0: W5500, Art-Net, sACN, REST API and dashboard transport
    Core 1: deterministic four-port DMX frame engine
    PIO:    250 kbit/s, 8N2 UART payload

  The dashboard is a single flash-resident document. Large Ethernet writes are
  retried in 512-byte blocks and UDP is serviced between blocks, preventing the
  partial-page fault seen with a single large EthernetClient::print() call.
*/

#include <Arduino.h>
#include <SPI.h>
#include <Ethernet.h>
#include <EthernetUdp.h>
#include <EEPROM.h>
#include "hardware/pio.h"
#include "hardware/clocks.h"
#include "hardware/watchdog.h"
#include "pico/time.h"     // 64-bit RP2040 system uptime
#include "hardware/sync.h" // Spinlock RP2040

#define HARDWARE_LED_PIN 23 

// Manage the PIO program loading offset to avoid duplicate loading that could cause the Core to freeze
static int pio0_offset = -1;
static int pio1_offset = -1;

// The flag indicates that the system has completed booting (Core cross-conflict error prevention)
volatile bool systemReady = false;
volatile uint32_t core1_heartbeat = 0; // Heart rate counter for safe watchdog loading between 2 cores
spin_lock_t* dmx_lock = nullptr;

// ================= PIO DMX DRIVER =================
// PIO UART TX 250 kbit/s, 8 data bits, no parity, 2 stop bits (DMX512 8N2).
// State-machine clock = 1 MHz, therefore one PIO cycle = 1 us.
// Each serial bit lasts 4 PIO cycles = 4 us.
//
// Equivalent PIO source:
//   .program dmx_tx
//   .side_set 1 opt
//   .wrap_target
//       pull block      side 1
//       set x, 7        side 0 [3]
//   bitloop:
//       out pins, 1            [2]
//       jmp x-- bitloop
//       nop             side 1 [6]
//   .wrap
static const uint16_t dmx_program_instructions[] = {
    0x98a0, // pull block side 1
    0xf327, // set x, 7 side 0 [3]
    0x6201, // out pins, 1 [2]
    0x0042, // jmp x--, 2
    0xbe42  // nop side 1 [6]
};
static const struct pio_program dmx_program = { dmx_program_instructions, 5, -1 };

class PIODMX {
private:
    PIO pio; uint sm; uint offset; uint pin; pio_sm_config c;
public:
    void begin(PIO pio_hw, uint sm_num, uint tx_pin) {
        pio = pio_hw; sm = sm_num; pin = tx_pin;
        
        if (pio == pio0) {
            if (pio0_offset == -1) {
                pio0_offset = pio_add_program(pio, &dmx_program);
            }
            offset = pio0_offset;
        } else {
            if (pio1_offset == -1) {
                pio1_offset = pio_add_program(pio, &dmx_program);
            }
            offset = pio1_offset;
        }

        c = pio_get_default_sm_config();
        sm_config_set_wrap(&c, offset + 0, offset + 4);
        sm_config_set_out_pins(&c, pin, 1);
        sm_config_set_sideset_pins(&c, pin);
        sm_config_set_sideset(&c, 2, true, false); // .side_set 1 opt
        sm_config_set_out_shift(&c, true, false, 32);
        sm_config_set_fifo_join(&c, PIO_FIFO_JOIN_TX);
        sm_config_set_clkdiv(&c, (float)clock_get_hz(clk_sys) / (250000.0f * 4.0f));

        // Establish MARK/idle HIGH before handing the pin to PIO.
        pio_sm_set_pins_with_mask(pio, sm, 1u << pin, 1u << pin);
        pio_sm_set_pindirs_with_mask(pio, sm, 1u << pin, 1u << pin);
        pio_gpio_init(pio, pin);

        pio_sm_init(pio, sm, offset, &c);
        pio_sm_set_enabled(pio, sm, true);
    }
    
    // Push 1 byte into FIFO (Do not block the thread)
    inline bool put_byte(uint8_t b) {
        if (pio_sm_is_tx_fifo_full(pio, sm)) return false;
        pio_sm_put(pio, sm, b);
        return true;
    }

    // Get program offset
    uint getOffset() const { return offset; }
    
    // Arm the UART state machine immediately after the CPU-generated MAB.
    void reset_sm() {
        pio_sm_set_enabled(pio, sm, false);
        pio_sm_restart(pio, sm);
        pio_sm_clear_fifos(pio, sm);
        pio_sm_exec(pio, sm, pio_encode_jmp(offset));
        pio_sm_clkdiv_restart(pio, 1u << sm);

        // Return the GPIO to this PIO block before enabling the SM.
        pio_gpio_init(pio, pin);
        pio_sm_set_consecutive_pindirs(pio, sm, pin, 1, true);
        pio_sm_set_enabled(pio, sm, true);
    }
};

PIODMX dmxOutputs[4];

// ================= HARDWARE ASSIGNMENT =================
#define PIN_MISO 16
#define PIN_CS   17
#define PIN_SCK  18
#define PIN_MOSI 19
#define PIN_RST  20
const uint8_t RS485_PINS[4] = {8, 9, 14, 15};

byte mac[] = { 0x02, 0x4E, 0x44, 0x34, 0x55, 0x01 };
EthernetServer server(80);
EthernetUDP artnetUdp;
EthernetUDP sacnDdp;             // Unicast sACN Socket
EthernetUDP sacnMulticastUdp[4]; // Multicast sACN Sockets per Universe/Port

#define ARTNET_PORT 6454
#define SACN_PORT   5568

#define DEVICE_MODEL       "ND DMX NODE 4U"
#define FIRMWARE_VERSION   "2.0.2-stable-final"
#define HARDWARE_REVISION  "RP2040 + W5500 + 4x RS485"
#define DASHBOARD_REFRESH_MS 1000
#define EVENT_LOG_SIZE 10

enum OutputTestMode : uint8_t {
  TEST_NETWORK = 0,
  TEST_BLACKOUT = 1,
  TEST_HALF = 2,
  TEST_FULL = 3,
  TEST_CHASE = 4
};

struct EventLogEntry {
  uint32_t timestampMs;
  char message[58];
};

// CONFIGURATION STRUCTURE V2
struct Config {
  uint16_t startUniverse; 
  uint8_t manualMode; 
  uint16_t portUniverses[4]; 
  uint8_t portEnabled[4];
  uint8_t portProtocol[4]; // 0: AUTO, 1: ARTNET, 2: SACN
  uint8_t mergeMode;       // 0: LTP, 1: HTP, 2: BLOCK
} cfg;

struct SystemDiagnostics {
  uint32_t core0Loops;
  uint32_t core1Loops;
  uint32_t maxNetTimeUs;
  uint32_t totalPacketsReceived;
} sysLog;

enum DmxTxState {
  STATE_IDLE = 0,
  STATE_BREAK,
  STATE_MAB,
  STATE_SENDING
};

struct PortStatus {
  uint16_t universe; bool active; uint32_t lastPacketMs;
  uint32_t frameCount; uint32_t lastFpsMs; float fps; uint16_t usedChannels;
  volatile uint32_t dmxFrameCount; uint32_t lastDmxFpsMs; float dmxFps;
  uint8_t currentPriority; IPAddress sender; char protocol[8];
  
  // Conflict Detection
  bool conflict;
  IPAddress conflictIP;
  uint32_t lastConflictMs;

  // DOUBLE BUFFERING ARCHITECTURE
  uint8_t dmxBuffer[513];       // Back-buffer (Core 0 ghi)
  uint8_t activeDmxBuffer[513]; // Front-buffer (Core 1 đọc)
  volatile bool hasNewData; 
  uint32_t nextFrameTimeUs;     // The microsecond interval at which the next frame is allowed to be sent.
  
  // Unblocked transmission state
  DmxTxState state;
  uint32_t stateStartTimeUs;
  uint16_t txIndex;

  // Output test override. Network data remains in dmxBuffer and resumes immediately when stopped.
  volatile uint8_t testMode;
  uint16_t chaseChannel;
  uint32_t lastChaseStepMs;
};

PortStatus ports[4]; 
EventLogEntry eventLog[EVENT_LOG_SIZE];
uint8_t eventLogHead = 0;
uint8_t eventLogCount = 0;
uint8_t packetBuffer[768]; 
auto lastLinkStatus = LinkON;

volatile uint32_t lCount0 = 0, lCount1 = 0, maxNetTime = 0;

// ================= EEPROM ENGINE =================
uint8_t calcCRC(const Config& target) {
  uint8_t crc = lowByte(target.startUniverse) + highByte(target.startUniverse) + target.manualMode + target.mergeMode;
  for(int i=0; i<4; i++) {
    crc += lowByte(target.portUniverses[i]) + highByte(target.portUniverses[i]) + target.portEnabled[i] + target.portProtocol[i];
  }
  return crc;
}

void saveConfig() {
  EEPROM.write(0, 0x51); // Magic header for v2
  EEPROM.write(1, lowByte(cfg.startUniverse)); EEPROM.write(2, highByte(cfg.startUniverse)); EEPROM.write(3, cfg.manualMode);
  for(int i=0; i<4; i++) {
    EEPROM.write(4+(i*2), lowByte(cfg.portUniverses[i])); EEPROM.write(5+(i*2), highByte(cfg.portUniverses[i]));
    EEPROM.write(12+i, cfg.portEnabled[i]);
    EEPROM.write(16+i, cfg.portProtocol[i]);
  }
  EEPROM.write(20, cfg.mergeMode);
  EEPROM.write(21, calcCRC(cfg)); EEPROM.commit();
}

void setupSacnSockets(); // Forward declaration

void loadConfig() {
  EEPROM.begin(64);
  Config temp;
  temp.startUniverse = EEPROM.read(1) | (EEPROM.read(2) << 8);
  temp.manualMode = EEPROM.read(3);
  for(int i=0; i<4; i++) {
    temp.portUniverses[i] = EEPROM.read(4+(i*2)) | (EEPROM.read(5+(i*2)) << 8);
    temp.portEnabled[i] = EEPROM.read(12+i);
    temp.portProtocol[i] = EEPROM.read(16+i);
  }
  temp.mergeMode = EEPROM.read(20);
  
  uint8_t crc = calcCRC(temp);
  
  if (EEPROM.read(0) == 0x51 && EEPROM.read(21) == crc) {
    cfg = temp;
  } else {
    // Default settings
    cfg.startUniverse = 1; cfg.manualMode = 0; cfg.mergeMode = 0; // 0 = LTP
    for(int i=0; i<4; i++) { 
      cfg.portUniverses[i] = i + 1; 
      cfg.portEnabled[i] = 1; 
      cfg.portProtocol[i] = 0; // 0 = AUTO
    }
    saveConfig();
  }
}

void updateUniverseMap() {
  for (int i = 0; i < 4; i++) {
    ports[i].universe = (cfg.manualMode == 1) ? cfg.portUniverses[i] : (cfg.startUniverse + i);
    ports[i].active = false; ports[i].fps = 0; ports[i].usedChannels = 0; strcpy(ports[i].protocol, "-");
    ports[i].conflict = false; ports[i].hasNewData = false; ports[i].lastFpsMs = millis(); ports[i].nextFrameTimeUs = 0;
    ports[i].dmxFrameCount = 0; ports[i].lastDmxFpsMs = millis(); ports[i].dmxFps = 0;
    ports[i].state = STATE_IDLE; ports[i].txIndex = 0;
    ports[i].testMode = TEST_NETWORK; ports[i].chaseChannel = 1; ports[i].lastChaseStepMs = 0;
    memset((void*)ports[i].dmxBuffer, 0, 513);
    memset((void*)ports[i].activeDmxBuffer, 0, 513);
  }
  setupSacnSockets(); // Update the sACN Multicast Sockets
}

// Initialize sACN Multicast sockets according to the universe of each port
void setupSacnSockets() {
  sacnDdp.stop();
  sacnDdp.begin(SACN_PORT); // Unicast sACN
  
  for (int i = 0; i < 4; i++) {
    sacnMulticastUdp[i].stop();
    uint16_t u = ports[i].universe;
    if (cfg.portEnabled[i] && u > 0) {
      bool alreadyJoined = false;
      for (int j = 0; j < i; j++) {
        if (cfg.portEnabled[j] && ports[j].universe == u) {
          alreadyJoined = true;
          break;
        }
      }
      if (!alreadyJoined) {
        // ANSI E1.31 standard sACN Multicast address: 239.255.A.B (where Universe = A*256 + B)
        IPAddress mIP(239, 255, (u >> 8) & 0xFF, u & 0xFF);
        sacnMulticastUdp[i].beginMulticast(mIP, SACN_PORT);
      }
    }
  }
}

// ================= CORE 0: NETWORK & WEB SERVER =================
uint16_t getUsedChannels(uint8_t *data, uint16_t len) {
  for (int i = len - 1; i >= 0; i--) if (data[i] != 0) return i + 1;
  return 0;
}


void addEvent(const char* message) {
  EventLogEntry &entry = eventLog[eventLogHead];
  entry.timestampMs = millis();
  strncpy(entry.message, message, sizeof(entry.message) - 1);
  entry.message[sizeof(entry.message) - 1] = '\0';
  eventLogHead = (eventLogHead + 1) % EVENT_LOG_SIZE;
  if (eventLogCount < EVENT_LOG_SIZE) eventLogCount++;
}

void addPortEvent(int portIndex, const char* detail) {
  char message[58];
  snprintf(message, sizeof(message), "Port %d %s", portIndex + 1, detail);
  addEvent(message);
}

const char* testModeName(uint8_t mode) {
  switch (mode) {
    case TEST_BLACKOUT: return "BLACKOUT";
    case TEST_HALF: return "50 PERCENT";
    case TEST_FULL: return "FULL";
    case TEST_CHASE: return "CHASE";
    default: return "NETWORK";
  }
}

void printMac(EthernetClient& c) {
  for (int i = 0; i < 6; i++) {
    if (i) c.print(':');
    if (mac[i] < 16) c.print('0');
    c.print(mac[i], HEX);
  }
}

// Generate an ArtPollReply packet (240 bytes) and send it to the automatic detection software
void sendArtPollReply(IPAddress remoteIP)
{
    uint8_t reply[240];
    memset(reply, 0, sizeof(reply));

    // Art-Net Header
    memcpy(reply, "Art-Net\0", 8);

    // OpPollReply (0x2100)
    reply[8] = 0x00;
    reply[9] = 0x21;

    // IP Address
    IPAddress ip = Ethernet.localIP();
    reply[10] = ip[0];
    reply[11] = ip[1];
    reply[12] = ip[2];
    reply[13] = ip[3];

    // Port 0x1936 = 6454
    reply[14] = 0x36;
    reply[15] = 0x19;

    // Firmware version v1.0
    reply[16] = 0x00;
    reply[17] = 0x01;

    // NetSwitch / SubSwitch
    uint16_t u = ports[0].universe - 1;
    reply[18] = (u >> 8) & 0x7F;
    reply[19] = (u >> 4) & 0x0F;

    // OEM Code
    reply[20] = 0xFF;
    reply[21] = 0xFF;

    reply[22] = 0x00; // UBEA Version
    reply[23] = 0x08; // Status1: Normal
    reply[24] = 0x00; // ESTA Manufacturer
    reply[25] = 0x00;

    // Short Name (18 bytes)
    strncpy((char*)&reply[26], "ND DMX System", 17);

    // Long Name (64 bytes)
    strncpy((char*)&reply[44], "ND DMX System 4-Port Node", 63);

    // Node Report
    snprintf((char*)&reply[108], 63, "#0001 [0000] ND DMX System OK");

    // NumPorts = 4
    reply[172] = 0x00;
    reply[173] = 0x04;

    // Port Types (DMX Output = 0x80)
    for(int i = 0; i < 4; i++) reply[174 + i] = 0x80;

    // GoodInput
    memset(reply + 178, 0, 4);

    // GoodOutput
    for(int i = 0; i < 4; i++) reply[182 + i] = ports[i].active ? 0x80 : 0x00;

    // SwIn
    memset(reply + 186, 0, 4);

    // SwOut
    for(int i = 0; i < 4; i++) reply[190 + i] = (ports[i].universe - 1) & 0x0F;

    // Video/Macro/Spare
    memset(reply + 194, 0, 7);

    reply[201] = 0x00; // Style = StNode

    // MAC Address
    memcpy(reply + 202, mac, 6);

    // Bind IP
    reply[208] = ip[0]; reply[209] = ip[1]; reply[210] = ip[2]; reply[211] = ip[3];

    // Bind Index & Status2
    reply[212] = 1;
    reply[213] = 0x08; // Status2: Art-Net 4 support

    memset(reply + 214, 0, 26); // GoodOutputB

    // Send Unicast responses to the detection computer
    artnetUdp.beginPacket(remoteIP, ARTNET_PORT);
    artnetUdp.write(reply, 240);
    artnetUdp.endPacket();
}

void processDmxData(int i, uint8_t* d, uint16_t len, uint8_t prio, IPAddress ip, const char* name) {
  uint32_t now = millis();
  bool wasActive = ports[i].active;
  
  // 1. Check the Protocol per Port configuration (0: AUTO, 1: ARTNET, 2: SACN)
  if (cfg.portProtocol[i] == 1 && strcmp(name, "Art-Net") != 0) return;
  if (cfg.portProtocol[i] == 2 && strcmp(name, "sACN") != 0) return;

  // 2. Source IP address conflict detection (Conflict Detection)
  if (ports[i].active && (now - ports[i].lastPacketMs < 1000) && ip != ports[i].sender) {
    bool isNewConflict = !ports[i].conflict;
    ports[i].conflict = true;
    ports[i].conflictIP = ip;
    ports[i].lastConflictMs = now;
    if (isNewConflict) addPortEvent(i, "source conflict detected");
  }

  // 3. Process Merge Policy Mode = 2 (BLOCK)
  if (cfg.mergeMode == 2) {
    if (ports[i].active && (now - ports[i].lastPacketMs < 1000) && ip != ports[i].sender) {
      return; // Chặn nguồn IP thứ 2
    }
  }

  // 4. Check sACN Priority
  if (ports[i].active && strcmp(ports[i].protocol, "sACN") == 0 && prio < ports[i].currentPriority && (now - ports[i].lastPacketMs < 1000)) return; 
  
  ports[i].active = true; ports[i].lastPacketMs = now; ports[i].currentPriority = prio;
  ports[i].sender = ip;
  
  strncpy(ports[i].protocol, name, sizeof(ports[i].protocol) - 1);
  ports[i].protocol[sizeof(ports[i].protocol) - 1] = '\0';
  
  if (len > 512) len = 512;
  ports[i].usedChannels = getUsedChannels(d, len);
  
  uint32_t irq_status = spin_lock_blocking(dmx_lock);
  
  // 5. Merge Policy Mode = 1 (HTP - Highest Takes Precedence)
  if (cfg.mergeMode == 1 && ports[i].active) {
    for (uint16_t k = 0; k < len; k++) {
      if (d[k] > ports[i].dmxBuffer[1 + k]) {
        ports[i].dmxBuffer[1 + k] = d[k];
      }
    }
  } else { 
    // Merge Policy Mode = 0 (LTP - Latest)
    memcpy(ports[i].dmxBuffer + 1, d, len);
    if (len < 512) memset(ports[i].dmxBuffer + 1 + len, 0, 512 - len);
  }
  
  ports[i].hasNewData = true; 
  spin_unlock(dmx_lock, irq_status);
  
  if (!wasActive) {
    char detail[46];
    snprintf(detail, sizeof(detail), "%s source active", name);
    addPortEvent(i, detail);
  }

  ports[i].frameCount++; sysLog.totalPacketsReceived++;
}

// sACN Packet Extraction Function (ANSI E1.31 Standard Packet)
void parseSacnPacket(EthernetUDP& udp) {
  int sacnSize = udp.parsePacket();
  if (sacnSize >= 126 && sacnSize <= (int)sizeof(packetBuffer)) {
    udp.read(packetBuffer, sacnSize);
    
    // Check the ACN Packet Identifier ("ASC-E1.17" at byte 4-12)
    if (memcmp(packetBuffer + 4, "ASC-E1.17", 9) == 0) {
      // Root Vector (0x04) & Framing Vector (0x02)
      if (packetBuffer[21] == 0x04 && packetBuffer[43] == 0x02) {
        const uint16_t u =
            (static_cast<uint16_t>(packetBuffer[113]) << 8) |
            packetBuffer[114];
        const uint16_t rawLen =
            (static_cast<uint16_t>(packetBuffer[123]) << 8) |
            packetBuffer[124];

        // Property value count includes the DMX start code at byte 125.
        // Reject malformed/truncated packets before reading slot data.
        if (rawLen < 1u || rawLen > 513u ||
            static_cast<uint32_t>(126u + (rawLen - 1u)) >
                static_cast<uint32_t>(sacnSize) ||
            packetBuffer[125] != 0u) {
          return;
        }

        const uint16_t len = rawLen - 1u;
        const uint8_t prio = packetBuffer[108];

        for (int i = 0; i < 4; i++) {
          if (u == ports[i].universe && cfg.portEnabled[i]) {
            processDmxData(
                i, packetBuffer + 126, len, prio, udp.remoteIP(), "sACN");
            break;
          }
        }
      }
    }
  }
}

void handleNetworkPackets() {
  // 1. ART-NET PACKET PROCESSING
  int artSize = artnetUdp.parsePacket();
  if (artSize >= 10 && artSize <= (int)sizeof(packetBuffer)) {
    artnetUdp.read(packetBuffer, artSize);
    if (memcmp(packetBuffer, "Art-Net", 8) == 0) {
      uint16_t opcode = packetBuffer[8] | (packetBuffer[9] << 8);
      if (opcode == 0x5000) { // ArtDmx
        if (artSize >= 18) {
          uint16_t len = (packetBuffer[16] << 8) | packetBuffer[17];
          if (18 + len <= artSize) {
            uint16_t u = packetBuffer[14] | (packetBuffer[15] << 8);
            for (int i = 0; i < 4; i++) {
              if (u == ports[i].universe && cfg.portEnabled[i]) {
                processDmxData(i, packetBuffer + 18, len, 100, artnetUdp.remoteIP(), "Art-Net");
                break;
              }
            }
          }
        }
      } else if (opcode == 0x2000) { // ArtPoll
        sendArtPollReply(artnetUdp.remoteIP());
      }
    }
  }

  // 2. PROCESSING sACN PACKETS (BOTH UNICAST AND MULTICAST FROM LIGHTKEY)
  parseSacnPacket(sacnDdp); // Unicast sACN
  for (int i = 0; i < 4; i++) {
    parseSacnPacket(sacnMulticastUdp[i]); // Multicast sACN per Port
  }
}

int getParamValue(const char* req, const char* key) {
  char searchKey[16]; snprintf(searchKey, sizeof(searchKey), "%s=", key);
  char* pos = strstr((char*)req, searchKey); if (!pos) return -1;
  return atoi(pos + strlen(searchKey));
}

void printIP(EthernetClient& c, IPAddress ip) {
  c.print(ip[0]); c.print('.');
  c.print(ip[1]); c.print('.');
  c.print(ip[2]); c.print('.');
  c.print(ip[3]);
}

static const uint8_t INDEX_HTML_GZ[] = {
  0x1F, 0x8B, 0x08, 0x00, 0x00, 0x00, 0x00, 0x00, 0x02, 0xFF, 0xD5, 0x3D, 0xD9, 0x72, 0xDB, 0x48,
  0x92, 0xEF, 0xFE, 0x0A, 0x98, 0x1E, 0x1B, 0xE4, 0x18, 0xA0, 0x00, 0xF0, 0x10, 0x45, 0x8A, 0xD4,
  0xCA, 0xB2, 0x3C, 0xD6, 0xB6, 0x2C, 0x39, 0x24, 0xB9, 0x7B, 0x3A, 0x3A, 0x3A, 0x3A, 0x40, 0xA2,
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  0xD6, 0x24, 0x9A, 0x4D, 0x07, 0x4F, 0xFE, 0x1F, 0xB3, 0xAC, 0x2E, 0x11, 0xFE, 0x87, 0x00, 0x00,
};

// W5500/EthernetClient may accept only part of a large write. This routine
// retries partial writes in small blocks and services UDP between blocks, so
// opening the dashboard does not starve Art-Net/sACN reception on Core 0.
bool writeAll(EthernetClient& client, const uint8_t* data, size_t length) {
  const size_t CHUNK_SIZE = 512;
  size_t sent = 0;
  uint32_t lastProgressMs = millis();

  while (sent < length && client.connected()) {
    const size_t remaining = length - sent;
    const size_t block = remaining > CHUNK_SIZE ? CHUNK_SIZE : remaining;
    const size_t written = client.write(data + sent, block);

    if (written > 0) {
      sent += written;
      lastProgressMs = millis();

      // Keep network DMX responsive while a browser downloads the page.
      handleNetworkPackets();
      watchdog_update();
    } else {
      if (millis() - lastProgressMs > 1500) break;
      handleNetworkPackets();
      watchdog_update();
      delay(1);
    }
  }
  return sent == length;
}

bool writeAll(EthernetClient& client, const char* data, size_t length) {
  return writeAll(client, reinterpret_cast<const uint8_t*>(data), length);
}

void sendStaticHeader(EthernetClient& client, const char* status, const char* contentType, size_t contentLength, const char* cacheControl) {
  char header[320];
  const int count = snprintf(
    header, sizeof(header),
    "HTTP/1.1 %s\r\n"
    "Content-Type: %s\r\n"
    "Content-Length: %lu\r\n"
    "Cache-Control: %s\r\n"
    "X-Content-Type-Options: nosniff\r\n"
    "Connection: close\r\n\r\n",
    status, contentType, static_cast<unsigned long>(contentLength), cacheControl
  );
  if (count > 0) writeAll(client, header, static_cast<size_t>(count));
}

void sendDynamicJsonHeader(EthernetClient& client, bool ok = true) {
  client.println(ok ? F("HTTP/1.1 200 OK") : F("HTTP/1.1 400 Bad Request"));
  client.println(F("Content-Type: application/json; charset=utf-8"));
  client.println(F("Cache-Control: no-store, no-cache, must-revalidate"));
  client.println(F("X-Content-Type-Options: nosniff"));
  client.println(F("Connection: close"));
  client.println();
}

void printJsonString(EthernetClient& client, const char* value) {
  client.print('"');
  if (value) {
    for (const char* p = value; *p; ++p) {
      const char ch = *p;
      if (ch == '"' || ch == '\\') {
        client.print('\\');
        client.print(ch);
      } else if (ch == '\n') {
        client.print(F("\\n"));
      } else if (static_cast<uint8_t>(ch) >= 0x20) {
        client.print(ch);
      }
    }
  }
  client.print('"');
}

void printMacString(EthernetClient& client) {
  client.print('"');
  for (int i = 0; i < 6; ++i) {
    if (i) client.print(':');
    if (mac[i] < 16) client.print('0');
    client.print(mac[i], HEX);
  }
  client.print('"');
}

uint64_t getSystemUptimeSeconds() {
  return time_us_64() / 1000000ULL;
}

void printUInt64(EthernetClient& client, uint64_t value) {
  char buffer[24];
  snprintf(buffer, sizeof(buffer), "%llu",
           static_cast<unsigned long long>(value));
  client.print(buffer);
}

void sendStatusJson(EthernetClient& client) {
  sendDynamicJsonHeader(client, true);
  const uint32_t now = millis();

  client.print(F("{\"model\":")); printJsonString(client, DEVICE_MODEL);
  client.print(F(",\"firmware\":")); printJsonString(client, FIRMWARE_VERSION);
  client.print(F(",\"hardware\":")); printJsonString(client, HARDWARE_REVISION);
  client.print(F(",\"build\":"));
  client.print('"'); client.print(__DATE__); client.print(' '); client.print(__TIME__); client.print('"');
  client.print(F(",\"mac\":")); printMacString(client);
  client.print(F(",\"ip\":"));
  client.print('"'); printIP(client, Ethernet.localIP()); client.print('"');
  client.print(F(",\"link\":")); client.print(Ethernet.linkStatus() == LinkON ? F("true") : F("false"));
  client.print(F(",\"mode\":")); client.print(cfg.manualMode);
  client.print(F(",\"start\":")); client.print(cfg.startUniverse);
  client.print(F(",\"merge\":")); client.print(cfg.mergeMode);
  client.print(F(",\"uptime\":")); printUInt64(client, getSystemUptimeSeconds());
  client.print(F(",\"c0\":")); client.print(sysLog.core0Loops);
  client.print(F(",\"c1\":")); client.print(sysLog.core1Loops);
  client.print(F(",\"net\":")); client.print(sysLog.maxNetTimeUs);
  client.print(F(",\"packets\":")); client.print(sysLog.totalPacketsReceived);
  client.print(F(",\"ports\":["));

  for (int i = 0; i < 4; ++i) {
    if (i) client.print(',');
    client.print(F("{\"port\":")); client.print(i + 1);
    client.print(F(",\"en\":")); client.print(cfg.portEnabled[i] ? 1 : 0);
    client.print(F(",\"pmode\":")); client.print(cfg.portProtocol[i]);
    client.print(F(",\"universe\":")); client.print(ports[i].universe);
    client.print(F(",\"active\":")); client.print(ports[i].active ? F("true") : F("false"));
    client.print(F(",\"conflict\":")); client.print(ports[i].conflict ? F("true") : F("false"));
    client.print(F(",\"fps\":")); client.print(ports[i].fps, 1);
    client.print(F(",\"dmxFps\":")); client.print(ports[i].dmxFps, 1);
    client.print(F(",\"used\":")); client.print(ports[i].usedChannels);
    client.print(F(",\"age\":")); client.print(ports[i].active ? now - ports[i].lastPacketMs : 0);
    client.print(F(",\"prio\":")); client.print(ports[i].currentPriority);
    client.print(F(",\"test\":")); client.print(ports[i].testMode);
    client.print(F(",\"proto\":")); printJsonString(client, ports[i].protocol);
    client.print(F(",\"sender\":")); client.print('"'); printIP(client, ports[i].sender); client.print('"');
    client.print(F(",\"c_ip\":")); client.print('"'); printIP(client, ports[i].conflictIP); client.print('"');
    client.print('}');
  }

  client.print(F("],\"events\":["));
  for (uint8_t n = 0; n < eventLogCount; ++n) {
    if (n) client.print(',');
    const int index = (eventLogHead + EVENT_LOG_SIZE - 1 - n) % EVENT_LOG_SIZE;
    client.print(F("{\"t\":")); client.print(eventLog[index].timestampMs);
    client.print(F(",\"m\":")); printJsonString(client, eventLog[index].message);
    client.print('}');
  }
  client.print(F("]}"));
}

void sendJsonResult(EthernetClient& client, bool ok, const char* message = nullptr) {
  sendDynamicJsonHeader(client, ok);
  client.print(F("{\"ok\":")); client.print(ok ? F("true") : F("false"));
  if (message) {
    client.print(ok ? F(",\"message\":") : F(",\"error\":"));
    printJsonString(client, message);
  }
  client.print('}');
}

void sendTestResponse(EthernetClient& client, const char* requestLine) {
  const int port = getParamValue(requestLine, "p");
  const int mode = getParamValue(requestLine, "m");

  if (port < 0 || port >= 4 || mode < TEST_NETWORK || mode > TEST_CHASE) {
    sendJsonResult(client, false, "Invalid port or test mode");
    return;
  }
  if (mode != TEST_NETWORK && !cfg.portEnabled[port]) {
    sendJsonResult(client, false, "Enable the port before starting a test");
    return;
  }

  const uint32_t irq = spin_lock_blocking(dmx_lock);
  ports[port].testMode = static_cast<uint8_t>(mode);
  ports[port].chaseChannel = 1;
  ports[port].lastChaseStepMs = 0;
  spin_unlock(dmx_lock, irq);

  char detail[50];
  snprintf(detail, sizeof(detail), "test mode %s", testModeName(static_cast<uint8_t>(mode)));
  addPortEvent(port, detail);
  sendJsonResult(client, true, "Test mode updated");
}

bool applyConfigFromRequest(const char* requestLine, char* error, size_t errorSize) {
  const int mode = getParamValue(requestLine, "mode");
  const int start = getParamValue(requestLine, "start");
  const int merge = getParamValue(requestLine, "merge");

  if (mode < 0 || mode > 1) {
    snprintf(error, errorSize, "Routing mode must be 0 or 1");
    return false;
  }
  if (start < 1 || start > 63996) {
    snprintf(error, errorSize, "Start universe must be 1 to 63996");
    return false;
  }
  if (merge < 0 || merge > 2) {
    snprintf(error, errorSize, "Merge mode must be 0 to 2");
    return false;
  }

  Config next = cfg;
  next.manualMode = static_cast<uint8_t>(mode);
  next.startUniverse = static_cast<uint16_t>(start);
  next.mergeMode = static_cast<uint8_t>(merge);

  for (int i = 0; i < 4; ++i) {
    char key[4];
    snprintf(key, sizeof(key), "u%d", i);
    const int universe = getParamValue(requestLine, key);
    snprintf(key, sizeof(key), "e%d", i);
    const int enabled = getParamValue(requestLine, key);
    snprintf(key, sizeof(key), "p%d", i);
    const int protocol = getParamValue(requestLine, key);

    if (universe < 1 || universe > 63999 || enabled < 0 || enabled > 1 || protocol < 0 || protocol > 2) {
      snprintf(error, errorSize, "Invalid configuration for Port %d", i + 1);
      return false;
    }
    next.portUniverses[i] = static_cast<uint16_t>(universe);
    next.portEnabled[i] = static_cast<uint8_t>(enabled);
    next.portProtocol[i] = static_cast<uint8_t>(protocol);
  }

  cfg = next;
  saveConfig();
  updateUniverseMap();
  addEvent("Configuration saved");
  return true;
}

void sendConfigResponse(EthernetClient& client, const char* requestLine) {
  char error[72] = {0};
  const bool ok = applyConfigFromRequest(requestLine, error, sizeof(error));
  sendJsonResult(client, ok, ok ? "Configuration saved" : error);
}

void sendDashboardPage(EthernetClient& client) {
  const size_t pageLength = sizeof(INDEX_HTML_GZ);
  char header[384];
  const int count = snprintf(
      header, sizeof(header),
      "HTTP/1.1 200 OK\r\n"
      "Content-Type: text/html; charset=utf-8\r\n"
      "Content-Encoding: gzip\r\n"
      "Content-Length: %lu\r\n"
      "Cache-Control: public, max-age=3600\r\n"
      "Vary: Accept-Encoding\r\n"
      "X-Content-Type-Options: nosniff\r\n"
      "Connection: close\r\n\r\n",
      static_cast<unsigned long>(pageLength));

  if (count > 0) {
    writeAll(client, header, static_cast<size_t>(count));
    writeAll(client, INDEX_HTML_GZ, pageLength);
  }
}

bool readRequestLine(EthernetClient& client, char* output, size_t capacity) {
  if (!output || capacity < 2) return false;
  size_t index = 0;
  const uint32_t started = millis();

  while (client.connected() && millis() - started < 300) {
    while (client.available()) {
      const char ch = static_cast<char>(client.read());
      if (ch == '\n') {
        output[index] = '\0';
        return index > 0;
      }
      if (ch != '\r' && index < capacity - 1) output[index++] = ch;
    }
    watchdog_update();
    delay(1);
  }
  output[index] = '\0';
  return index > 0;
}

void handleWeb() {
  EthernetClient client = server.available();
  if (!client) return;

  char requestLine[512] = {0};
  if (!readRequestLine(client, requestLine, sizeof(requestLine))) {
    client.stop();
    return;
  }

  if (strncmp(requestLine, "GET /api/status", 15) == 0) {
    sendStatusJson(client);
  } else if (strncmp(requestLine, "GET /api/test?", 14) == 0) {
    sendTestResponse(client, requestLine);
  } else if (strncmp(requestLine, "GET /api/config?", 16) == 0) {
    sendConfigResponse(client, requestLine);
  } else if (strncmp(requestLine, "GET /set?", 9) == 0) {
    char error[72] = {0};
    const bool ok = applyConfigFromRequest(requestLine, error, sizeof(error));
    if (ok) {
      client.println(F("HTTP/1.1 303 See Other"));
      client.println(F("Location: /"));
      client.println(F("Connection: close"));
      client.println();
    } else {
      sendJsonResult(client, false, error);
    }
  } else if (strncmp(requestLine, "GET /favicon.ico", 16) == 0) {
    client.println(F("HTTP/1.1 204 No Content"));
    client.println(F("Connection: close"));
    client.println();
  } else if (strncmp(requestLine, "GET / ", 6) == 0 || strncmp(requestLine, "GET /index.html", 15) == 0) {
    sendDashboardPage(client);
  } else {
    static const char NOT_FOUND[] = "Not found";
    sendStaticHeader(client, "404 Not Found", "text/plain; charset=utf-8", sizeof(NOT_FOUND) - 1, "no-store");
    writeAll(client, NOT_FOUND, sizeof(NOT_FOUND) - 1);
  }

  delay(2);
  client.stop();
}


void setup() {
  // USB CDC is provided by the Arduino-Pico USB stack.
  // Do not wait forever for Serial: the node must also boot without a computer attached.
  Serial.begin(115200);
  delay(1000);
  Serial.println();
  Serial.println(F("[BOOT] ND DMX NODE 4U v2.0.2 STABLE FINAL"));
  Serial.println(F("[BOOT] USB CDC started"));

  pinMode(HARDWARE_LED_PIN, OUTPUT);
  digitalWrite(HARDWARE_LED_PIN, LOW);

  // EEPROM depends on the flash size selected in Arduino IDE.
  // For a standard Raspberry Pi Pico, select the real 2MB flash layout.
  loadConfig();
  Serial.println(F("[BOOT] Configuration loaded"));

  // Initialize all DMX PIO state machines before releasing Core 1.
  for (int i = 0; i < 4; i++) {
    dmxOutputs[i].begin(i < 2 ? pio0 : pio1, i % 2, RS485_PINS[i]);
  }
  Serial.println(F("[BOOT] DMX PIO ready"));

  int lock_num = spin_lock_claim_unused(true);
  dmx_lock = spin_lock_init(lock_num);
  Serial.println(F("[BOOT] Spinlock ready"));

  // Initialize the W5500 BEFORE opening UDP sockets.
  pinMode(PIN_RST, OUTPUT);
  digitalWrite(PIN_RST, LOW);
  delay(100);
  digitalWrite(PIN_RST, HIGH);
  delay(500);

  SPI.setRX(PIN_MISO);
  SPI.setCS(PIN_CS);
  SPI.setSCK(PIN_SCK);
  SPI.setTX(PIN_MOSI);
  SPI.begin();
  Ethernet.init(PIN_CS);
  Serial.println(F("[BOOT] SPI/W5500 interface ready"));

  IPAddress staticIP(10, 10, 10, 10);
  IPAddress dnsServer(10, 10, 10, 1);
  IPAddress gateway(10, 10, 10, 1);
  IPAddress subnetMask(255, 255, 255, 0);
  Ethernet.begin(mac, staticIP, dnsServer, gateway, subnetMask);

  lastLinkStatus = Ethernet.linkStatus();

  // updateUniverseMap() also opens the sACN sockets, so it must run only
  // after SPI and Ethernet have been initialized.
  updateUniverseMap();

  server.begin();
  artnetUdp.begin(ARTNET_PORT);

  addEvent("System boot complete");
  addEvent(lastLinkStatus == LinkON ? "Ethernet link connected" : "Ethernet link unavailable");

  Serial.print(F("[BOOT] IP: "));
  Serial.println(Ethernet.localIP());
  Serial.println(F("[BOOT] Network services ready"));

  watchdog_enable(8388, 1);

  asm volatile("dmb" : : : "memory");
  systemReady = true;
  asm volatile("sev");

  Serial.println(F("[BOOT] Core 1 released"));
  Serial.println(F("[BOOT] Startup complete"));
}

void loop() {
  watchdog_update();
  
  // Synchronized security protects both Core 1 and Core 1 from Watchdog inter-core
  static uint32_t lastWDCheck = 0;
  static uint32_t lastHeartbeat = 0;
  static uint8_t missedHeartbeats = 0;

  if (millis() - lastWDCheck >= 1000) {
    const uint32_t currentHeartbeat =
        __atomic_load_n(&core1_heartbeat, __ATOMIC_RELAXED);

    if (currentHeartbeat == lastHeartbeat) {
      if (++missedHeartbeats >= 3) {
        // Recover automatically instead of leaving the node without DMX.
        watchdog_reboot(0, 0, 100);
        while (true) { }
      }
    } else {
      lastHeartbeat = currentHeartbeat;
      missedHeartbeats = 0;
    }

    lastWDCheck = millis();
  }
  
  static uint32_t lastLinkCheck = 0;
  if (millis() - lastLinkCheck >= 1000) {
    auto currentLink = Ethernet.linkStatus();
    if (lastLinkStatus == LinkOFF && currentLink == LinkON) {
      artnetUdp.stop(); setupSacnSockets(); artnetUdp.begin(ARTNET_PORT);
      addEvent("Ethernet link restored");
    } else if (lastLinkStatus == LinkON && currentLink == LinkOFF) {
      addEvent("Ethernet link lost");
    }
    lastLinkStatus = currentLink; lastLinkCheck = millis();
  }

  uint32_t t_start = micros();
  handleNetworkPackets(); 
  uint32_t t_duration = micros() - t_start;
  if (t_duration > maxNetTime) maxNetTime = t_duration;

  uint32_t now = millis();
  for (int i = 0; i < 4; i++) {
    if (ports[i].active && (now - ports[i].lastPacketMs > 1000)) {
      ports[i].active = false; strcpy(ports[i].protocol, "-"); ports[i].fps = 0; ports[i].usedChannels = 0; ports[i].currentPriority = 0;
      addPortEvent(i, "network source lost");
    }
    // Automatically remove the Conflict flag after 2 seconds if IP duplication stops
    if (ports[i].conflict && (now - ports[i].lastConflictMs > 2000)) {
      ports[i].conflict = false;
      addPortEvent(i, "source conflict cleared");
    }
    if (now - ports[i].lastFpsMs >= 1000) {
      ports[i].fps = (ports[i].frameCount * 1000.0f) / (now - ports[i].lastFpsMs);
      ports[i].frameCount = 0; ports[i].lastFpsMs = now;
    }
    if (now - ports[i].lastDmxFpsMs >= 1000) {
      uint32_t outputFrames = __atomic_exchange_n(&ports[i].dmxFrameCount, 0u, __ATOMIC_RELAXED);
      ports[i].dmxFps = (outputFrames * 1000.0f) / (now - ports[i].lastDmxFpsMs);
      ports[i].lastDmxFpsMs = now;
    }
  }
  
  handleWeb();          

  lCount0++;
  static uint32_t lastReportMs = 0;
  if (millis() - lastReportMs >= 1000) {
    sysLog.core0Loops = lCount0;
    sysLog.core1Loops = __atomic_exchange_n(&lCount1, 0u, __ATOMIC_RELAXED);
    sysLog.maxNetTimeUs = maxNetTime;
    lCount0 = 0;
    maxNetTime = 0;
    lastReportMs = millis();
  }

  static uint32_t lastLED = 0;
  if (millis() - lastLED > 300) { digitalWrite(HARDWARE_LED_PIN, !digitalRead(HARDWARE_LED_PIN)); lastLED = millis(); }
}

// ================= CORE 1: INDEPENDENT DMX SIGNAL OUTPUT =================
void setup1() {
  // It's completely empty because the hardware has been safely initialized by Core 0 in setup()
}

// DMX statefuls transmission system is non-blocking and multi-thread safe
void handleDmxTransmit(int i) {
  const uint32_t nowMs = millis();
  const uint32_t nowUs = micros();
  const uint pin = RS485_PINS[i];

  switch (ports[i].state) {
    case STATE_IDLE: {
      const int32_t timeRemaining =
          static_cast<int32_t>(ports[i].nextFrameTimeUs - nowUs);

      // Only enter the shared-buffer critical section when a new frame is
      // actually due. This reduces spinlock traffic from hundreds of thousands
      // of claims per second to about 160 short claims per second (4 x 40 Hz).
      if (timeRemaining <= 0) {
        const uint32_t irqStatus = spin_lock_blocking(dmx_lock);

        const uint8_t testMode = ports[i].testMode;
        if (testMode == TEST_BLACKOUT) {
          memset(ports[i].activeDmxBuffer, 0, 513);
        } else if (testMode == TEST_HALF) {
          ports[i].activeDmxBuffer[0] = 0;
          memset(ports[i].activeDmxBuffer + 1, 128, 512);
        } else if (testMode == TEST_FULL) {
          ports[i].activeDmxBuffer[0] = 0;
          memset(ports[i].activeDmxBuffer + 1, 255, 512);
        } else if (testMode == TEST_CHASE) {
          if (nowMs - ports[i].lastChaseStepMs >= 100) {
            ports[i].chaseChannel++;
            if (ports[i].chaseChannel > 512) {
              ports[i].chaseChannel = 1;
            }
            ports[i].lastChaseStepMs = nowMs;
          }

          memset(ports[i].activeDmxBuffer, 0, 513);
          ports[i].activeDmxBuffer[ports[i].chaseChannel] = 255;
        } else if (ports[i].hasNewData) {
          memcpy(ports[i].activeDmxBuffer, ports[i].dmxBuffer, 513);
          ports[i].hasNewData = false;
        }

        spin_unlock(dmx_lock, irqStatus);

        // The 25 ms period is measured from BREAK start: approximately 40 Hz.
        ports[i].nextFrameTimeUs = nowUs + 25000u;

        // Generate the DMX BREAK with SIO.
        pinMode(pin, OUTPUT);
        digitalWrite(pin, LOW);

        ports[i].state = STATE_BREAK;
        ports[i].stateStartTimeUs = nowUs;
        __atomic_fetch_add(
            &ports[i].dmxFrameCount, 1u, __ATOMIC_RELAXED);
      }
      break;
    }

    case STATE_BREAK:
      // DMX512 requires at least 88 us BREAK.
      if (static_cast<uint32_t>(
              nowUs - ports[i].stateStartTimeUs) >= 105u) {
        digitalWrite(pin, HIGH);
        ports[i].state = STATE_MAB;
        ports[i].stateStartTimeUs = nowUs;
      }
      break;

    case STATE_MAB:
      // DMX512 requires at least 8 us Mark After Break.
      if (static_cast<uint32_t>(
              nowUs - ports[i].stateStartTimeUs) >= 14u) {
        dmxOutputs[i].reset_sm();
        ports[i].state = STATE_SENDING;
        ports[i].stateStartTimeUs = nowUs;
        ports[i].txIndex = 0;
      }
      break;

    case STATE_SENDING: {
      uint8_t fed = 0;
      while (ports[i].txIndex < 513 && fed < 16) {
        if (!dmxOutputs[i].put_byte(
                ports[i].activeDmxBuffer[ports[i].txIndex])) {
          break;
        }

        ports[i].txIndex++;
        fed++;
      }

      if (ports[i].txIndex >= 513) {
        ports[i].state = STATE_IDLE;
      } else if (static_cast<uint32_t>(
                     nowUs - ports[i].stateStartTimeUs) > 35000u) {
        // A full 513-slot DMX frame is normally about 22.7 ms. Recover a
        // stalled PIO/FIFO instead of leaving Core 1 stuck indefinitely.
        dmxOutputs[i].reset_sm();
        ports[i].txIndex = 0;
        ports[i].state = STATE_IDLE;
        ports[i].nextFrameTimeUs = nowUs + 1000u;
      }
      break;
    }

    default:
      dmxOutputs[i].reset_sm();
      ports[i].txIndex = 0;
      ports[i].state = STATE_IDLE;
      ports[i].nextFrameTimeUs = nowUs + 1000u;
      break;
  }
}

void loop1() {
  // Wait for the Core 0 system to be ready to use the Pico SDK Memory Barrier
  if (!systemReady) {
    while (!systemReady) {
      asm volatile("wfe");
    }
    asm volatile("dmb" : : : "memory");
  }

  __atomic_fetch_add(&lCount1, 1u, __ATOMIC_RELAXED);
  __atomic_fetch_add(&core1_heartbeat, 1u, __ATOMIC_RELAXED);
  
  for (int i = 0; i < 4; i++) {
    if (cfg.portEnabled[i] == 1) {
      handleDmxTransmit(i);
    }
  }
}